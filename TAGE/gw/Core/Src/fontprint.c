#include "stm32h7xx_hal.h"
#include "fontprint.h"

extern uint16_t* framebuffer;

uint8_t font[] = {
0,0,0,0,0,0,0,0,0,7,0,0,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0,
0,0,0,0,0,0,0,0,0,7,0,0,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0,
0,0,0,0,0,0,0,0,0,7,0,0,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0,
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0,7,0,0,0,0,0,0,0,0,0,0,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0,
};



#define ITOABUF_COUNT (10) // We can do this many itoa "simultaneously"
#define ITOABUF_LEN (12) // 32 bits is 10 digits, plus a - sign, plus ending 0

char itoabuff[ITOABUF_LEN*ITOABUF_COUNT];
int itoabuffactive = 0;

char* vtoaui(unsigned int _i, int _base, int _padding)
{
    if(_padding > ITOABUF_LEN-1) {
        _padding = ITOABUF_LEN-1;
    }
    
    char* pszRet = &itoabuff[itoabuffactive + ITOABUF_LEN-1];
    *pszRet = 0;

    unsigned int value = _i;
    
    do
    {
        char v = value % _base;
        pszRet--;
        if(v >= 10) {
            *pszRet = 'a' + (v-10);
        } else {
            *pszRet = '0' + v;
        }
        value /= _base;
        _padding--;
    } while(value > 0);
    
    while(_padding > 0) {
        pszRet--;
        *pszRet = '0';
        _padding--;
    }
    
    itoabuffactive += ITOABUF_LEN;
    if(itoabuffactive >= ITOABUF_LEN*ITOABUF_COUNT) {
        itoabuffactive = 0;
    }
    
    return pszRet;
}

char* vtoasi(int _i, int _base, int _padding)
{
    if(_padding > ITOABUF_LEN-2) {
        _padding = ITOABUF_LEN-2;
    }
    
    char* pszRet = &itoabuff[itoabuffactive + ITOABUF_LEN-1];
    *pszRet = 0;
    
    int value = _i;
    
    char negsign = 0;
    if(value < 0) {
        negsign = '-';
        value = -value;
    }
    
    do
    {
        char v = value % _base;
        pszRet--;
        if(v >= 10) {
            *pszRet = 'a' + (v-10);
        } else {
            *pszRet = '0' + v;
        }
        value /= _base;
        _padding--;
    } while(value > 0);
    
    while(_padding > 0) {
        pszRet--;
        *pszRet = '0';
        _padding--;
    }
    
    if(negsign) {
        pszRet--;
        *pszRet = negsign;
    }
    
    itoabuffactive += ITOABUF_LEN;
    if(itoabuffactive >= ITOABUF_LEN*ITOABUF_COUNT) {
        itoabuffactive = 0;
    }
    
    return pszRet;
}


void fontprint(const char* _pszMessage, int _x, int _y, uint16_t color) {
  int numchars = 0;
  while(_pszMessage[numchars] != 0) {
    numchars++;
  }

  for(int i=0; i<numchars; i++) {
    int c = _pszMessage[i];
    c -= 32;
    int cx = (c & 15) * 8;
    int cy = (c >> 4) * 8;
    for(int y=0; y<8; y++) {
      for(int x=0; x<8; x++) {
        int rdy = cy+y;
        int rdx = cx+x;
        if(font[rdy*128 + rdx]) {
          int wrx = (i*8)+_x+x;
          int wry = _y+y;
          if((wrx>=0)
          && (wrx<320)
          && (wry >= 0)
          && (wry < 240)) {
            framebuffer[wry*320 + wrx] = color;
          }
        }
      }
    }
  }
}
