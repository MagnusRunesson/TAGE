#include "stm32h7xx_hal.h"
#include "fontprint.h"

extern uint16_t framebuffer[];

uint8_t font[] = {
0,0,0,0,0,0,0,0,0,7,0,0,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0,
0,0,0,0,0,0,0,0,0,7,0,0,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0,
0,0,0,0,0,0,0,0,0,7,0,0,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0,
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0,7,0,0,0,0,0,0,0,0,0,0,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0,
};

void fontprint(const char* _pszMessage, int _x, int _y, uint16_t color) {
  int numchars = 0;
  while(_pszMessage[numchars] != 0) {
    numchars++;
  }

  for(int i=0; i<numchars; i++) {
    int c = _pszMessage[i];
    c -= 32;
    int cx = (c & 15) * 8;
    int cy = (c >> 4) * 8;
    for(int y=0; y<8; y++) {
      for(int x=0; x<8; x++) {
        int rdy = cy+y;
        int rdx = cx+x;
        if(font[rdy*128 + rdx]) {
          int wrx = (i*8)+_x+x;
          int wry = _y+y;
          if((wrx>=0)
          && (wrx<320)
          && (wry >= 0)
          && (wry < 240)) {
            framebuffer[wry*320 + wrx] = color;
          }
        }
      }
    }
  }
}